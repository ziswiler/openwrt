// SPDX-License-Identifier: GPL-2.0-or-later OR MIT

#include "ar9344_mikrotik_routerboard-2011.dtsi"

#include <dt-bindings/gpio/gpio.h>
#include <dt-bindings/input/input.h>

/ {
	compatible = "mikrotik,routerboard-2011il", "qca,ar9344";
	model = "MikroTik RouterBOARD 2011iL";
};
